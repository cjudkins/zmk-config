## boards/shields/logos/Kconfig.defconfig
```kconfig
if SHIELD_LOGOS_LEFT

config ZMK_KEYBOARD_NAME
    default "Logos"

config ZMK_SPLIT_ROLE_CENTRAL
    default y

endif # SHIELD_LOGOS_LEFT

if SHIELD_LOGOS_LEFT || SHIELD_LOGOS_RIGHT

config ZMK_SPLIT
    default y

# Trackball

config ZMK_POINTING
    default y

config SPI
    default y

config INPUT
    default y

config PMW3610
    default y

# I think this may already be the default, try with it disabled
#config NFCT_PINS_AS_GPIOS
#    default y

endif # SHIELD_LOGOS_LEFT || SHIELD_LOGOS_RIGHT
```

## boards/shields/logos/Kconfig.shield
```kconfig
config SHIELD_LOGOS_LEFT
    def_bool $(shields_list_contains,logos_left)

config SHIELD_LOGOS_RIGHT
    def_bool $(shields_list_contains,logos_right)
```

## config/west.yml
```yaml
manifest:
  remotes:
    - name: zmkfirmware
      url-base: https://github.com/zmkfirmware
    - name: badjeff
      url-base: https://github.com/badjeff
    - name: urob
      url-base: https://github.com/urob
    - name: caksoylar
      url-base: https://github.com/caksoylar
  projects:
    - name: zmk
      remote: zmkfirmware
      revision: v0.3
      import: app/west.yml
    - name: zmk-pmw3610-driver
      remote: badjeff
      revision: main
    - name: zmk-tri-state
      remote: urob
      revision: main
    - name: zmk-rgbled-widget
      remote: caksoylar
      revision: v0.3
  self:
    path: config
```
